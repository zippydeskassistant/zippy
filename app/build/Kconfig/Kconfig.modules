## app/build/Kconfig/Kconfig.modules
```kconfig
menu "zippy (/home/hlord/Documents/HelmutWork/zippy-workspace/zippy)"
osource "/home/hlord/Documents/HelmutWork/zippy-workspace/zippy/Kconfig"
config ZEPHYR_ZIPPY_MODULE
	bool
	default y
endmenu
menu "cmsis (/home/hlord/Documents/HelmutWork/zippy-workspace/modules/hal/cmsis)"
osource "$(ZEPHYR_CMSIS_KCONFIG)"
config ZEPHYR_CMSIS_MODULE
	bool
	default y
endmenu
menu "fatfs (/home/hlord/Documents/HelmutWork/zippy-workspace/modules/fs/fatfs)"
osource "$(ZEPHYR_FATFS_KCONFIG)"
config ZEPHYR_FATFS_MODULE
	bool
	default y
endmenu
menu "hal_nordic (/home/hlord/Documents/HelmutWork/zippy-workspace/modules/hal/nordic)"
osource "$(ZEPHYR_HAL_NORDIC_KCONFIG)"
config ZEPHYR_HAL_NORDIC_MODULE
	bool
	default y
endmenu
config ZEPHYR_STM32_MODULE
   bool
   default y
menu "lvgl (/home/hlord/Documents/HelmutWork/zippy-workspace/modules/lib/gui/lvgl)"
osource "/home/hlord/Documents/HelmutWork/zippy-workspace/modules/lib/gui/lvgl/Kconfig"
config ZEPHYR_LVGL_MODULE
	bool
	default y
endmenu
menu "segger (/home/hlord/Documents/HelmutWork/zippy-workspace/modules/debug/segger)"
osource "$(ZEPHYR_SEGGER_KCONFIG)"
config ZEPHYR_SEGGER_MODULE
	bool
	default y
endmenu
```

## app/build/Kconfig/Kconfig.shield
```kconfig
osource "/home/hlord/Documents/HelmutWork/zippy-workspace/zippy/app/boards/shields/*/Kconfig.shield"
osource "/home/hlord/Documents/HelmutWork/zippy-workspace/zippy/boards/shields/*/Kconfig.shield"
osource "/home/hlord/Documents/HelmutWork/zippy-workspace/zippy/boards/shields/*/Kconfig.shield"
```

## app/build/Kconfig/Kconfig.shield.defconfig
```kconfig
osource "/home/hlord/Documents/HelmutWork/zippy-workspace/zippy/app/boards/shields/*/Kconfig.defconfig"
osource "/home/hlord/Documents/HelmutWork/zippy-workspace/zippy/boards/shields/*/Kconfig.defconfig"
```

## app/build/Kconfig/arch/Kconfig
```kconfig
# Load arch Kconfig descriptions.
osource "/home/hlord/Documents/HelmutWork/zippy-workspace/zephyr/arch/x86/Kconfig"
osource "/home/hlord/Documents/HelmutWork/zippy-workspace/zephyr/arch/xtensa/Kconfig"
osource "/home/hlord/Documents/HelmutWork/zippy-workspace/zephyr/arch/sparc/Kconfig"
osource "/home/hlord/Documents/HelmutWork/zippy-workspace/zephyr/arch/riscv/Kconfig"
osource "/home/hlord/Documents/HelmutWork/zippy-workspace/zephyr/arch/posix/Kconfig"
osource "/home/hlord/Documents/HelmutWork/zippy-workspace/zephyr/arch/nios2/Kconfig"
osource "/home/hlord/Documents/HelmutWork/zippy-workspace/zephyr/arch/mips/Kconfig"
osource "/home/hlord/Documents/HelmutWork/zippy-workspace/zephyr/arch/arm64/Kconfig"
osource "/home/hlord/Documents/HelmutWork/zippy-workspace/zephyr/arch/arm/Kconfig"
osource "/home/hlord/Documents/HelmutWork/zippy-workspace/zephyr/arch/arc/Kconfig"
```

## app/build/Kconfig/soc/Kconfig
```kconfig
# Load Zephyr SoC Kconfig descriptions.
osource "/home/hlord/Documents/HelmutWork/zippy-workspace/zephyr/soc/xlnx/zynqmp/Kconfig"
osource "/home/hlord/Documents/HelmutWork/zippy-workspace/zephyr/soc/xlnx/zynq7000/Kconfig"
osource "/home/hlord/Documents/HelmutWork/zippy-workspace/zephyr/soc/xen/Kconfig"
osource "/home/hlord/Documents/HelmutWork/zippy-workspace/zephyr/soc/ti/simplelink/Kconfig"
osource "/home/hlord/Documents/HelmutWork/zippy-workspace/zephyr/soc/ti/lm3s6965/Kconfig"
osource "/home/hlord/Documents/HelmutWork/zippy-workspace/zephyr/soc/ti/k3/Kconfig"
osource "/home/hlord/Documents/HelmutWork/zippy-workspace/zephyr/soc/telink/tlsr/Kconfig"
osource "/home/hlord/Documents/HelmutWork/zippy-workspace/zephyr/soc/starfive/jh71xx/Kconfig"
osource "/home/hlord/Documents/HelmutWork/zippy-workspace/zephyr/soc/st/stm32/Kconfig"
osource "/home/hlord/Documents/HelmutWork/zippy-workspace/zephyr/soc/snps/qemu_arc/Kconfig"
osource "/home/hlord/Documents/HelmutWork/zippy-workspace/zephyr/soc/snps/nsim/Kconfig"
osource "/home/hlord/Documents/HelmutWork/zippy-workspace/zephyr/soc/snps/hsdk4xd/Kconfig"
osource "/home/hlord/Documents/HelmutWork/zippy-workspace/zephyr/soc/snps/hsdk/Kconfig"
osource "/home/hlord/Documents/HelmutWork/zippy-workspace/zephyr/soc/snps/emsk/Kconfig"
osource "/home/hlord/Documents/HelmutWork/zippy-workspace/zephyr/soc/snps/emsdp/Kconfig"
osource "/home/hlord/Documents/HelmutWork/zippy-workspace/zephyr/soc/snps/arc_iot/Kconfig"
osource "/home/hlord/Documents/HelmutWork/zippy-workspace/zephyr/soc/silabs/Kconfig"
osource "/home/hlord/Documents/HelmutWork/zippy-workspace/zephyr/soc/sifive/sifive_freedom/Kconfig"
osource "/home/hlord/Documents/HelmutWork/zippy-workspace/zephyr/soc/rockchip/Kconfig"
osource "/home/hlord/Documents/HelmutWork/zippy-workspace/zephyr/soc/renode/riscv_virtual/Kconfig"
osource "/home/hlord/Documents/HelmutWork/zippy-workspace/zephyr/soc/renesas/smartbond/Kconfig"
osource "/home/hlord/Documents/HelmutWork/zippy-workspace/zephyr/soc/renesas/rzt2m/Kconfig"
osource "/home/hlord/Documents/HelmutWork/zippy-workspace/zephyr/soc/renesas/rcar/Kconfig"
osource "/home/hlord/Documents/HelmutWork/zippy-workspace/zephyr/soc/renesas/ra/Kconfig"
osource "/home/hlord/Documents/HelmutWork/zippy-workspace/zephyr/soc/raspberrypi/Kconfig"
osource "/home/hlord/Documents/HelmutWork/zippy-workspace/zephyr/soc/quicklogic/eos_s3/Kconfig"
osource "/home/hlord/Documents/HelmutWork/zippy-workspace/zephyr/soc/qemu/virt_riscv/Kconfig"
osource "/home/hlord/Documents/HelmutWork/zippy-workspace/zephyr/soc/qemu/malta/Kconfig"
osource "/home/hlord/Documents/HelmutWork/zippy-workspace/zephyr/soc/openisa/rv32m1/Kconfig"
osource "/home/hlord/Documents/HelmutWork/zippy-workspace/zephyr/soc/nxp/s32/Kconfig"
osource "/home/hlord/Documents/HelmutWork/zippy-workspace/zephyr/soc/nxp/rw/Kconfig"
osource "/home/hlord/Documents/HelmutWork/zippy-workspace/zephyr/soc/nxp/mcx/Kconfig"
osource "/home/hlord/Documents/HelmutWork/zippy-workspace/zephyr/soc/nxp/lpc/Kconfig"
osource "/home/hlord/Documents/HelmutWork/zippy-workspace/zephyr/soc/nxp/layerscape/Kconfig"
osource "/home/hlord/Documents/HelmutWork/zippy-workspace/zephyr/soc/nxp/kinetis/Kconfig"
osource "/home/hlord/Documents/HelmutWork/zippy-workspace/zephyr/soc/nxp/imxrt/Kconfig"
osource "/home/hlord/Documents/HelmutWork/zippy-workspace/zephyr/soc/nxp/imx/Kconfig"
osource "/home/hlord/Documents/HelmutWork/zippy-workspace/zephyr/soc/nuvoton/numicro/Kconfig"
osource "/home/hlord/Documents/HelmutWork/zippy-workspace/zephyr/soc/nuvoton/numaker/Kconfig"
osource "/home/hlord/Documents/HelmutWork/zippy-workspace/zephyr/soc/nuvoton/npcx/Kconfig"
osource "/home/hlord/Documents/HelmutWork/zippy-workspace/zephyr/soc/nordic/Kconfig"
osource "/home/hlord/Documents/HelmutWork/zippy-workspace/zephyr/soc/neorv32/Kconfig"
osource "/home/hlord/Documents/HelmutWork/zippy-workspace/zephyr/soc/native/inf_clock/Kconfig"
osource "/home/hlord/Documents/HelmutWork/zippy-workspace/zephyr/soc/microchip/miv/Kconfig"
osource "/home/hlord/Documents/HelmutWork/zippy-workspace/zephyr/soc/microchip/mec/Kconfig"
osource "/home/hlord/Documents/HelmutWork/zippy-workspace/zephyr/soc/lowrisc/opentitan/Kconfig"
osource "/home/hlord/Documents/HelmutWork/zippy-workspace/zephyr/soc/litex/litex_vexriscv/Kconfig"
osource "/home/hlord/Documents/HelmutWork/zippy-workspace/zephyr/soc/ite/ec/Kconfig"
osource "/home/hlord/Documents/HelmutWork/zippy-workspace/zephyr/soc/intel/raptor_lake/Kconfig"
osource "/home/hlord/Documents/HelmutWork/zippy-workspace/zephyr/soc/intel/lakemont/Kconfig"
osource "/home/hlord/Documents/HelmutWork/zippy-workspace/zephyr/soc/intel/intel_socfpga_std/Kconfig"
osource "/home/hlord/Documents/HelmutWork/zippy-workspace/zephyr/soc/intel/intel_socfpga/Kconfig"
osource "/home/hlord/Documents/HelmutWork/zippy-workspace/zephyr/soc/intel/intel_niosv/Kconfig"
osource "/home/hlord/Documents/HelmutWork/zippy-workspace/zephyr/soc/intel/intel_ish/Kconfig"
osource "/home/hlord/Documents/HelmutWork/zippy-workspace/zephyr/soc/intel/intel_adsp/Kconfig"
osource "/home/hlord/Documents/HelmutWork/zippy-workspace/zephyr/soc/intel/elkhart_lake/Kconfig"
osource "/home/hlord/Documents/HelmutWork/zippy-workspace/zephyr/soc/intel/atom/Kconfig"
osource "/home/hlord/Documents/HelmutWork/zippy-workspace/zephyr/soc/intel/apollo_lake/Kconfig"
osource "/home/hlord/Documents/HelmutWork/zippy-workspace/zephyr/soc/intel/alder_lake/Kconfig"
osource "/home/hlord/Documents/HelmutWork/zippy-workspace/zephyr/soc/infineon/xmc/Kconfig"
osource "/home/hlord/Documents/HelmutWork/zippy-workspace/zephyr/soc/gd/gd32/Kconfig"
osource "/home/hlord/Documents/HelmutWork/zippy-workspace/zephyr/soc/gaisler/leon3/Kconfig"
osource "/home/hlord/Documents/HelmutWork/zippy-workspace/zephyr/soc/gaisler/gr716a/Kconfig"
osource "/home/hlord/Documents/HelmutWork/zippy-workspace/zephyr/soc/espressif/Kconfig"
osource "/home/hlord/Documents/HelmutWork/zippy-workspace/zephyr/soc/ene/kb1200/Kconfig"
osource "/home/hlord/Documents/HelmutWork/zippy-workspace/zephyr/soc/efinix/sapphire/Kconfig"
osource "/home/hlord/Documents/HelmutWork/zippy-workspace/zephyr/soc/cypress/Kconfig"
osource "/home/hlord/Documents/HelmutWork/zippy-workspace/zephyr/soc/cdns/xtensa_sample_controller/Kconfig"
osource "/home/hlord/Documents/HelmutWork/zippy-workspace/zephyr/soc/cdns/dc233c/Kconfig"
osource "/home/hlord/Documents/HelmutWork/zippy-workspace/zephyr/soc/brcm/bcmvk/Kconfig"
osource "/home/hlord/Documents/HelmutWork/zippy-workspace/zephyr/soc/brcm/bcm2711/Kconfig"
osource "/home/hlord/Documents/HelmutWork/zippy-workspace/zephyr/soc/atmel/sam0/Kconfig"
osource "/home/hlord/Documents/HelmutWork/zippy-workspace/zephyr/soc/atmel/sam/Kconfig"
osource "/home/hlord/Documents/HelmutWork/zippy-workspace/zephyr/soc/aspeed/Kconfig"
osource "/home/hlord/Documents/HelmutWork/zippy-workspace/zephyr/soc/arm/Kconfig"
osource "/home/hlord/Documents/HelmutWork/zippy-workspace/zephyr/soc/arm/beetle/Kconfig"
osource "/home/hlord/Documents/HelmutWork/zippy-workspace/zephyr/soc/andestech/Kconfig"
osource "/home/hlord/Documents/HelmutWork/zippy-workspace/zephyr/soc/ambiq/Kconfig"
osource "/home/hlord/Documents/HelmutWork/zippy-workspace/zephyr/soc/altr/zephyr_nios2f/Kconfig"
osource "/home/hlord/Documents/HelmutWork/zippy-workspace/zephyr/soc/altr/qemu_nios2/Kconfig"
```

## west.yml
```yaml
# Copyright (c) 2021 Nordic Semiconductor ASA
# SPDX-License-Identifier: Apache-2.0

manifest:
  self:
    west-commands: scripts/west-commands.yml

  remotes:
    - name: zephyrproject-rtos
      url-base: https://github.com/zephyrproject-rtos
    - name: zippy
      url-base: https://github.com/zippydeskassistant

  projects:
    - name: zephyr
      remote: zippy 
      revision: v3.6+zippy
      import:
        # By using name-allowlist we can clone only the modules that are
        # strictly needed by the application.
        name-allowlist:
          - cmsis      # required by the ARM port
          - hal_nordic # required by the custom_plank board (Nordic based)
          - hal_stm32  # required by the nucleo_f302r8 board (STM32 based)
          - lvgl
          - segger
          - fatfs
          - littlefs
```
